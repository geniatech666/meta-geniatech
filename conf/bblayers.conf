## conf/bblayers.conf
```bitbake
# POKY_BBLAYERS_CONF_VERSION is increased each time build/conf/bblayers.conf
# changes incompatibly
POKY_BBLAYERS_CONF_VERSION = "2"

BBPATH = "${TOPDIR}"
BBFILES ?= ""

BBLAYERS ?= " \
  ${TOPDIR}/../meta-openembedded/meta-oe \
  ${TOPDIR}/../meta-openembedded/meta-python \
  ${TOPDIR}/../meta-openembedded/meta-networking \
  ${TOPDIR}/../meta-openembedded/meta-multimedia \
  ${TOPDIR}/../meta-qt5 \
  ${TOPDIR}/../meta-clang \
  ${TOPDIR}/../meta-rockchip \
  ${TOPDIR}/../meta-geniatech \
  ${TOPDIR}/../poky/meta \
  ${TOPDIR}/../poky/meta-poky \
  ${TOPDIR}/../poky/meta-yocto-bsp \
"
```

## conf/layer.conf
```bitbake
# We have a conf and classes directory, add to BBPATH
BBPATH .= ":${LAYERDIR}"

# We have recipes-* directories, add to BBFILES
BBFILES += "${LAYERDIR}/recipes-*/*/*.bb \
            ${LAYERDIR}/recipes-*/*/*.bbappend"

BBFILE_COLLECTIONS += "geniatech"
BBFILE_PATTERN_geniatech = "^${LAYERDIR}/"
BBFILE_PRIORITY_geniatech = "6"

LAYERDEPENDS_geniatech = "core"

# This should only be incremented on significant changes that will
# cause compatibility issues with other layers
LAYERVERSION_geniatech = "1"
LAYERSERIES_COMPAT_geniatech = "kirkstone langdale mickledore"
```

## conf/local.conf
```bitbake
include include/common.conf
include include/debug.conf
include include/display.conf
include include/multimedia.conf
include include/audio.conf
include include/wifibt.conf
#include include/browser.conf
include include/rksdk.conf

PREFERRED_VERSION_linux-rockchip := "5.10%"
LINUXLIBCVERSION := "5.10-custom%"
MALI_VERSION := "g13p0"

DISPLAY_PLATFORM := "x11"

#MACHINE = "rockchip-rk3568-evb"
```
